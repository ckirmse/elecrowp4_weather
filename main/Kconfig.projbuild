## main/Kconfig.projbuild
```kconfig
menu "Weather Station NTP"

config WIFI_SSID
    string "WiFi SSID"
    default ""
    help
        SSID of the network used for NTP time sync. Leave empty to skip sync.

config WIFI_PASSWORD
    string "WiFi Password"
    default ""
    help
        Password for the NTP WiFi network. Leave empty for open networks.

endmenu
```

## sdkconfig.defaults
```kconfig
# ESP32-P4 target
CONFIG_IDF_TARGET="esp32p4"

# P4 v1.x production silicon
CONFIG_ESP32P4_SELECTS_REV_LESS_V3=y
CONFIG_ESP32P4_REV_MIN_100=y

# 16MB flash
CONFIG_ESPTOOLPY_FLASHSIZE_16MB=y

# Custom partition table (2 MB app partition)
CONFIG_PARTITION_TABLE_CUSTOM=y
CONFIG_PARTITION_TABLE_CUSTOM_FILENAME="partitions.csv"

# P4 is dual-core RISC-V, 360MHz
CONFIG_ESP_DEFAULT_CPU_FREQ_MHZ_360=y

# P4 PSRAM — needed for 1024x600 framebuffers
CONFIG_SPIRAM=y
CONFIG_SPIRAM_SPEED_200M=y
CONFIG_SPIRAM_FETCH_INSTRUCTIONS=y
CONFIG_SPIRAM_RODATA=y

# Disable Xtensa/ARM-specific LVGL optimizations (P4 is RISC-V)
CONFIG_LV_USE_DRAW_ARM2D_SYNC=n
CONFIG_LV_USE_NATIVE_HELIUM_ASM=n

# mbedTLS: P4 v1.x has no ECDSA hardware
CONFIG_MBEDTLS_HARDWARE_ECDSA_SIGN=n
CONFIG_MBEDTLS_HARDWARE_ECDSA_VERIFY=n

# ESP32-C6 companion chip WiFi via SDIO 1-bit bus (Slot 1).
# ESP_HOST_WIFI_ENABLED must NOT be set — it disables esp_wifi_remote's Kconfig,
# which is the only place SLAVE_IDF_TARGET_* symbols are defined. Without those,
# ESP_HOSTED_CP_TARGET_ESP32C6 can't be selected and transport falls back to SPI/H2.
# Correct path: ESP_WIFI_REMOTE_ENABLED=y (default) loads the slave-select
# Kconfig, auto-selects C6 for P4, enables ESP_HOSTED_PRIV_SDIO_OPTION, and
# defaults the transport to SDIO.
CONFIG_IDF_EXPERIMENTAL_FEATURES=y
CONFIG_SLAVE_IDF_TARGET_ESP32C6=y
CONFIG_ESP_HOSTED_SDIO_HOST_INTERFACE=y
CONFIG_ESP_HOSTED_SDIO_1_BIT_BUS=y
# SDIO pin defaults for P4 slot 1: CMD=19, CLK=18, D0=14, D1=15.
# Only the reset pin differs (board uses GPIO32; esp_hosted default for P4 is 54).
CONFIG_ESP_HOSTED_SDIO_GPIO_RESET_SLAVE=32
CONFIG_WIFI_RMT_NVS_ENABLED=n

# Reduce SDIO DMA queue depth to fit in P4's 137 KB internal DMA-capable RAM.
CONFIG_ESP_HOSTED_SDIO_TX_Q_SIZE=5
CONFIG_ESP_HOSTED_SDIO_RX_Q_SIZE=5

# FreeRTOS at 1kHz for accurate timing
CONFIG_FREERTOS_HZ=1000

# Task watchdog disabled (weather station is well-behaved)
CONFIG_ESP_TASK_WDT_EN=n

# LVGL via menuconfig — use clib for stdlib functions
CONFIG_LV_USE_CLIB_MALLOC=y
CONFIG_LV_USE_CLIB_STRING=y
CONFIG_LV_USE_CLIB_SPRINTF=y
CONFIG_LV_DEF_REFR_PERIOD=16

# Disable colour formats we don't use (RGB565 only)
CONFIG_LV_DRAW_SW_SUPPORT_XRGB8888=n
CONFIG_LV_DRAW_SW_SUPPORT_L8=n
CONFIG_LV_DRAW_SW_SUPPORT_AL88=n
CONFIG_LV_DRAW_SW_SUPPORT_A8=n
CONFIG_LV_DRAW_SW_SUPPORT_I1=n

# Fonts — built-in Montserrat for UI text
CONFIG_LV_FONT_MONTSERRAT_14=n
CONFIG_LV_FONT_MONTSERRAT_16=y
CONFIG_LV_FONT_MONTSERRAT_24=y
CONFIG_LV_FONT_DEFAULT_UNSCII_8=y
CONFIG_LV_USE_FONT_COMPRESSED=y

# Disable unused LVGL widgets to save flash
CONFIG_LV_USE_CALENDAR=n
CONFIG_LV_USE_CANVAS=n
CONFIG_LV_USE_CHART=n
CONFIG_LV_USE_IMAGEBUTTON=n
CONFIG_LV_LABEL_TEXT_SELECTION=n
CONFIG_LV_LABEL_LONG_TXT_HINT=n
CONFIG_LV_USE_MSGBOX=n
CONFIG_LV_USE_SPINBOX=n
CONFIG_LV_USE_TABVIEW=n
CONFIG_LV_USE_WIN=n
CONFIG_LV_BIN_DECODER_RAM_LOAD=y
CONFIG_LV_USE_RLE=y
CONFIG_LV_BUILD_EXAMPLES=n
```
